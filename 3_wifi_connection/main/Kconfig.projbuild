## 3_wifi_connection/main/Kconfig.projbuild
```kconfig
menu "Example Configuration"

    config EXAMPLE_BOARD_BUTTON_GPIO
        int "Boot Button GPIO"
        default 28 if IDF_TARGET_ESP32C5
        default 9 if IDF_TARGET_ESP32C3 || IDF_TARGET_ESP32C6 || IDF_TARGET_ESP32C2 || IDF_TARGET_ESP32H2
        default 0
        help
            GPIO number on which the "Boot" button is connected. This is generally used
            by the application for custom operations like toggling states, resetting to defaults, etc.

    config EXAMPLE_OUTPUT_GPIO
        int "Output GPIO"
        default 19
        help
            This is an output GPIO that will be connected to a relay or other driver circuit in most cases.
            If the power changes, this GPIO output level will also change.

    config WS2812_LED_GPIO
        int "WS2812 LED GPIO"
        default 27 if IDF_TARGET_ESP32C5
        default 8 if IDF_TARGET_ESP32C3 || IDF_TARGET_ESP32C6 || IDF_TARGET_ESP32H2
        default 48 if IDF_TARGET_ESP32S3
        default 18
        help
            Set the WS2812 RGB LED GPIO.

endmenu
```

## 4_network_config/sdkconfig.defaults
```kconfig
CONFIG_PARTITION_TABLE_SINGLE_APP=
CONFIG_PARTITION_TABLE_TWO_OTA=
CONFIG_PARTITION_TABLE_CUSTOM=y
CONFIG_PARTITION_TABLE_CUSTOM_FILENAME="partitions.csv"
CONFIG_PARTITION_TABLE_FILENAME="partitions.csv"
CONFIG_PARTITION_TABLE_OFFSET=0x8000
CONFIG_ENABLE_UNIFIED_PROVISIONING=y
CONFIG_LWIP_NETIF_LOOPBACK=y
CONFIG_LWIP_LOOPBACK_MAX_PBUFS=2
```

## 6_ota/sdkconfig.defaults
```kconfig
CONFIG_PARTITION_TABLE_SINGLE_APP=
CONFIG_PARTITION_TABLE_TWO_OTA=
CONFIG_PARTITION_TABLE_CUSTOM=y
CONFIG_PARTITION_TABLE_CUSTOM_FILENAME="partitions.csv"
CONFIG_PARTITION_TABLE_FILENAME="partitions.csv"
CONFIG_PARTITION_TABLE_OFFSET=0x8000
CONFIG_AWS_IOT_SDK=y
CONFIG_AWS_IOT_SHADOW_MAX_SIZE_OF_THING_NAME=40
CONFIG_ENABLE_UNIFIED_PROVISIONING=y
CONFIG_LWIP_NETIF_LOOPBACK=y
CONFIG_LWIP_LOOPBACK_MAX_PBUFS=2
CONFIG_MBEDTLS_SSL_IN_CONTENT_LEN=16384
CONFIG_MBEDTLS_SSL_OUT_CONTENT_LEN=1024
```

## 7_mfg/main/Kconfig.projbuild
```kconfig
menu "Example Configuration"

    config EXAMPLE_BOARD_BUTTON_GPIO
        int "Boot Button GPIO"
        default 28 if IDF_TARGET_ESP32C5
        default 9 if IDF_TARGET_ESP32C3 || IDF_TARGET_ESP32C6 || IDF_TARGET_ESP32C2 || IDF_TARGET_ESP32H2
        default 0
        help
            GPIO number on which the "Boot" button is connected. This is generally used
            by the application for custom operations like toggling states, resetting to defaults, etc.

    config EXAMPLE_OUTPUT_GPIO
        int "Output GPIO"
        default 19
        help
            This is an output GPIO that will be connected to a relay or other driver circuit in most cases.
            If the power changes, this GPIO output level will also change.

    config WS2812_LED_GPIO
        int "WS2812 LED GPIO"
        default 27 if IDF_TARGET_ESP32C5
        default 8 if IDF_TARGET_ESP32C3 || IDF_TARGET_ESP32C6 || IDF_TARGET_ESP32C2 || IDF_TARGET_ESP32H2
        default 48 if IDF_TARGET_ESP32S3
        default 18
        help
            GPIO number for WS2812 LED strip control.

    choice EXAMPLE_PROV_TRANSPORT
        bool "Provisioning Transport"
        default EXAMPLE_PROV_TRANSPORT_SOFTAP if IDF_TARGET_ESP32S2
        default EXAMPLE_PROV_TRANSPORT_BLE
        help
            Wi-Fi provisioning component offers both, SoftAP and BLE transports. Choose any one.

        config EXAMPLE_PROV_TRANSPORT_BLE
            bool "BLE"
            select BT_ENABLED
            depends on !IDF_TARGET_ESP32S2
            help
                Use Bluetooth Low Energy for provisioning. Not available on ESP32-S2.

        config EXAMPLE_PROV_TRANSPORT_SOFTAP
            bool "Soft AP"
            select LWIP_IPV4
            help
                Use SoftAP (Wi-Fi Access Point) for provisioning. Device creates its own Wi-Fi network.
    endchoice

endmenu
```
